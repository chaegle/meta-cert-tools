## conf/layer.conf
```bitbake
# We have a conf and classes directory, add to BBPATH
BBPATH .= ":${LAYERDIR}"

# We have recipes-* directories, add to BBFILES
BBFILES += "${LAYERDIR}/recipes-*/*/*.bb \
	${LAYERDIR}/recipes-*/*/*.bbappend"

BBFILE_COLLECTIONS += "cert-tools"
BBFILE_PATTERN_cert-tools = "^${LAYERDIR}/"
BBFILE_PRIORITY_cert-tools = "6"

LAYERSERIES_COMPAT_cert-tools = "daisy jethro morty rocko thud zeus gatesgarth"
```
